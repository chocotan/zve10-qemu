## source/kernel/zve10_defconfig
```kconfig
CONFIG_EXPERIMENTAL=y
CONFIG_LOCALVERSION="+"
# CONFIG_LOCALVERSION_AUTO is not set
CONFIG_SYSVIPC=y
CONFIG_EJ_RCU_SONY=y
CONFIG_CGROUPS=y
CONFIG_RESOURCE_COUNTERS=y
CONFIG_CGROUP_MEM_RES_CTLR=y
CONFIG_BLK_DEV_INITRD=y
CONFIG_INITRAMFS_SOURCE=""
# CONFIG_RD_GZIP is not set
CONFIG_CC_OPTIMIZE_FOR_SIZE=y
# CONFIG_SYSCTL_SYSCALL is not set
CONFIG_KLOG=y
# CONFIG_BASE_FULL is not set
# CONFIG_ETHTOOL is not set
# CONFIG_CRC32_TABLES is not set
# CONFIG_AIO is not set
# CONFIG_XATTR is not set
CONFIG_CC_FUNIT_AT_A_TIME=y
CONFIG_LINUXTINY_DO_UNINLINE=y
CONFIG_MAX_SWAPFILES_SHIFT=2
CONFIG_MAX_USER_RT_PRIO=160
CONFIG_EMBEDDED=y
CONFIG_MARKERS_STRUCT=y
# CONFIG_LTT is not set
CONFIG_SNSC_DEBUG_PROFILE_HEAP=y
CONFIG_SNSC_BOOT_TIME=y
CONFIG_SNSC_BOOT_TIME_MAX_COMMENT=64
CONFIG_SNSC_BOOT_TIME_RINGBUFFER=y
CONFIG_SNSC_DEFAULT_BOOT_TIME_BASE=0x0
CONFIG_SNSC_DEFAULT_BOOT_TIME_SIZE=0x0
CONFIG_MODULES=y
CONFIG_MODULE_FORCE_LOAD=y
CONFIG_MODULE_UNLOAD=y
CONFIG_SNSC_SKIP_VERIFY_EXPORT_SYMBOLS=y
# CONFIG_BLK_DEV_BSG is not set
# CONFIG_IOSCHED_DEADLINE is not set
# CONFIG_IOSCHED_CFQ is not set
CONFIG_ARCH_CXD900X0=y
CONFIG_CXD900X0_TEXT_OFFSET=0x138000
CONFIG_TASK_MMAP_OFFSET=0x04000000
CONFIG_CXD900X0_QEMU=y
CONFIG_SMP_COMMON_ENTRY=y
# CONFIG_SWP_EMULATE is not set
CONFIG_EJ_SIMPLE_ASID=y
CONFIG_CACHE_L2X0_LOCK_LENGTH=1024
CONFIG_EJ_IOREMAP_NORMAL=y
CONFIG_SNSC_NLVER_CUSTOMVER_ENABLE=y
CONFIG_SNSC_BOOT_FORMAT=y
CONFIG_SNSC_BOOT_BIN=y
CONFIG_SNSC_NULL_CONSOLE=y
CONFIG_SNSC_SKIP_SET_CPUS_ALLOWED_IN_PREVENT_MIGRATION=y
CONFIG_SNSC_ENABLE_INTERRUPT_IN_TICK_PERIODIC=y
CONFIG_EJ_HANDLE_HRTIMER_EXPIRE_IN_SOFTIRQ=y
CONFIG_EJ_USE_RAISE_SOFTIRQ_IRQOFF_IF_IRQ_DISABLED=y
CONFIG_EJ_SS_O1_LOAD_BALANCE=y
CONFIG_EJ_SS_REFINE_CPU_LOAD_CALC=y
CONFIG_EJ_SS_REDUCE_MIGRATION_FREQ=y
CONFIG_EJ_SS_REDUCE_OS_TIMER_LOAD=y
CONFIG_EJ_SS_PULL_RT_TASK=y
CONFIG_EJ_SS_MISC=y
CONFIG_SNSC_WORKQUEUE=y
CONFIG_EJ_LOG_ALWAYS_DUMPABLE=y
CONFIG_SNSC_FORCE_ENABLE_TTWU_QUEUE=y
CONFIG_SNSC_ARM_REDUCE_ICACHE_INVALIDATION=y
CONFIG_SNSC_DEBUG_STACK_USAGE=y
CONFIG_SNSC_SUPPORT_4KB_MAPPING=y
CONFIG_SNSC_LOCAL_TIMER_AVOID_WAKEUP_SOFTIRQ=y
CONFIG_SNSC_REMOVE_GIC_ACK_LOCK=y
CONFIG_EJ_ON_EACH_CPU_THREADED=y
CONFIG_EJ_ON_EACH_CPU_THREADED_ON_KIPID=y
CONFIG_SNSC_SCHED_FIX_YIELD_FOR_RT_TASKS=y
CONFIG_EJ_IRQ_ENABLE_SCHED_RET_TO_USER=y
CONFIG_EJ_EXPORT_RAISE_SOFT_INTERRUPT=y
CONFIG_THREAD_MONITOR=y
CONFIG_EJ_PL310_LOCKLESS=y
CONFIG_EJ_REDUCE_THREADINFO=y
CONFIG_MPCORE_GIC_INIT=y
CONFIG_SMP=y
CONFIG_VMSPLIT_1_5G=y
CONFIG_NUMA=y
CONFIG_PREEMPT_RT_FULL=y
CONFIG_SNSC_RT_NO_PUSH_IF_SLEEP=y
CONFIG_AEABI=y
# CONFIG_OABI_COMPAT is not set
CONFIG_EXCEPTION_MONITOR=y
CONFIG_NODES_SHIFT=4
CONFIG_SNSC_SECTION_NR_OUT_OF_PAGE_FLAG=y
CONFIG_SNSC_SPARSE_SECTION_SHIFT=20
CONFIG_SNSC_MAX_SECTION_GROUP_NR=128
CONFIG_SNSC_4K_KERNEL_COMMAND_LINE=y
CONFIG_SNSC_MEMPLUG=y
CONFIG_SNSC_RELEASE_ON_HOTREMOVE=y
CONFIG_SNSC_OOMK_ON_HOTREMOVE_FAILURE=y
CONFIG_SNSC_MEMORY_RESERVE_SUPPORT=y
CONFIG_SNSC_MAX_RESERVE_AREA=8
CONFIG_KSWAPD_SHOULD_ONLY_WAIT_ON_IO_IF_THERE_IS_IO=y
CONFIG_SNSC_KSWAPD_CMDLINE_DEF_PRIORITY=y
CONFIG_SNSC_KSWAPD_DYNAMIC_DEF_PRIORITY=y
CONFIG_SNSC_KEEP_ANON_PAGES_ACTIVE_IF_NO_SWAP_AVAILABLE=y
CONFIG_SNSC_POISON_FREED_INIT_PAGES=y
CONFIG_ZBOOT_ROM_TEXT=0x0
CONFIG_ZBOOT_ROM_BSS=0x0
CONFIG_CMDLINE="console=ttyAM0,115200n8 cfg.uart=1 mem=1G@0 rdinit=/init loglevel=8"
CONFIG_VFP=y
# CONFIG_CORE_DUMP_DEFAULT_ELF_HEADERS is not set
CONFIG_SNSC_SSBOOT=y
# CONFIG_SNSC_SSBOOT_PAGE_STAT is not set
# CONFIG_SNSC_SSBOOT_SBI is not set
CONFIG_SNSC_SSBOOT_BASIC_OPTIMIZER_PROFILE_NAME="/tmp/ssboot_prof.bin"
CONFIG_NET=y
CONFIG_PACKET=y
CONFIG_UNIX=y
CONFIG_INET=y
CONFIG_IP_MULTICAST=y
CONFIG_IP_ADVANCED_ROUTER=y
CONFIG_IP_ROUTE_MULTIPATH=y
CONFIG_IP_ROUTE_VERBOSE=y
CONFIG_IP_PNP=y
CONFIG_IP_PNP_DHCP=y
CONFIG_NET_IPIP=y
CONFIG_NET_IPGRE_DEMUX=y
CONFIG_NET_IPGRE=y
CONFIG_NET_IPGRE_BROADCAST=y
# CONFIG_INET_XFRM_MODE_TRANSPORT is not set
# CONFIG_INET_XFRM_MODE_TUNNEL is not set
# CONFIG_INET_XFRM_MODE_BEET is not set
# CONFIG_INET_LRO is not set
# CONFIG_INET_DIAG is not set
CONFIG_TCP_CONG_ADVANCED=y
# CONFIG_TCP_CONG_BIC is not set
# CONFIG_TCP_CONG_WESTWOOD is not set
# CONFIG_TCP_CONG_HTCP is not set
# CONFIG_IPV6 is not set
# CONFIG_WIRELESS is not set
CONFIG_DEVTMPFS=y
# CONFIG_FIRMWARE_IN_KERNEL is not set
CONFIG_BLK_DEV_LOOP=y
CONFIG_BLK_DEV_RAM=y
CONFIG_SCSI=m
CONFIG_BLK_DEV_SD=m
CONFIG_BLK_DEV_SR=m
CONFIG_SCSI_MULTI_LUN=y
CONFIG_ISCSI_TCP=m
CONFIG_NETDEVICES=y
CONFIG_SMSC_PHY=y
CONFIG_NET_ETHERNET=y
CONFIG_SMSC911X=y
# CONFIG_NETDEV_1000 is not set
# CONFIG_NETDEV_10000 is not set
# CONFIG_WLAN is not set
CONFIG_INPUT_EVDEV=y
# CONFIG_INPUT_MOUSE is not set
CONFIG_INPUT_MISC=y
CONFIG_INPUT_UINPUT=y
# CONFIG_VT is not set
# CONFIG_LEGACY_PTYS is not set
# CONFIG_DEVKMEM is not set
CONFIG_SERIAL_AMBA2=y
CONFIG_SERIAL_AMBA2_CONSOLE=y
# CONFIG_HW_RANDOM is not set
# CONFIG_HWMON is not set
# CONFIG_MFD_SUPPORT is not set
# CONFIG_HID_SUPPORT is not set
CONFIG_USB=m
# CONFIG_USB_DEFAULT_PERSIST is not set
CONFIG_USB_XHCI_HCD=m
CONFIG_USB_STORAGE=m
CONFIG_USB_GADGET=y
CONFIG_USB_MASS_STORAGE=m
CONFIG_MMC=y
CONFIG_MMC_ARMMMCI=y
CONFIG_RTC_CLASS=y
CONFIG_UIO=y
CONFIG_UIO_PDRV=y
CONFIG_OSAL_UDIF=y
# CONFIG_OSAL_UDIF_ERROR_PRINT is not set
CONFIG_EXT2_FS=y
CONFIG_FUSE_FS=y
CONFIG_VFAT_FS=y
CONFIG_FAT_DEFAULT_IOCHARSET="ascii"
CONFIG_TMPFS=y
CONFIG_CRAMFS=y
CONFIG_NFS_FS=y
CONFIG_NFS_V3=y
CONFIG_ROOT_NFS=y
CONFIG_PARTITION_ADVANCED=y
CONFIG_EFI_PARTITION=y
CONFIG_NLS_DEFAULT="ascii"
CONFIG_NLS_CODEPAGE_437=y
CONFIG_NLS_ASCII=y
CONFIG_NLS_UTF8=m
# CONFIG_SNSC_FS_FLUSH_HARDWARE_CACHE is not set
CONFIG_SNSC_FS_VFAT_POSIX_ATTR=y
CONFIG_SNSC_FS_FAT_LOOKUP_HINT=y
CONFIG_SNSC_FS_VFAT_AVOID_DOUBLE_LINK=y
CONFIG_SNSC_FS_FAT_UNIX_DATE=y
CONFIG_SNSC_FS_FAT_BATCH_SYNC=y
CONFIG_EJ_FS_IGNORE_UID_UNMATCH=y
CONFIG_PRINTK_TIME=y
CONFIG_PRINTK_SHORT_IRQ_DISABLE=y
CONFIG_MAGIC_SYSRQ=y
CONFIG_DEBUG_KERNEL=y
# CONFIG_SCHED_DEBUG is not set
# CONFIG_DEBUG_PREEMPT is not set
CONFIG_DEBUG_INFO=y
CONFIG_DEBUG_INFO_REDUCED=y
# CONFIG_ARM_UNWIND is not set
CONFIG_DEBUG_USER=y
CONFIG_DEBUG_LL=y
CONFIG_EARLY_PRINTK=y
CONFIG_CRYPTO=y
CONFIG_CRYPTO_AUTHENC=y
CONFIG_CRYPTO_CBC=y
CONFIG_CRYPTO_ECB=y
CONFIG_CRYPTO_HMAC=y
CONFIG_CRYPTO_MD5=y
CONFIG_CRYPTO_MICHAEL_MIC=y
CONFIG_CRYPTO_SHA1=y
CONFIG_CRYPTO_AES=y
CONFIG_CRYPTO_ARC4=y
CONFIG_CRYPTO_DES=y
CONFIG_CRYPTO_DEFLATE=y
# CONFIG_CRYPTO_ANSI_CPRNG is not set
# CONFIG_CRYPTO_HW is not set
CONFIG_LZ77_INFLATE=y
CONFIG_AVERAGE=y
```
